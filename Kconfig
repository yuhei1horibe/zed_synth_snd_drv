## Kconfig
```kconfig
# SPDX-License-Identifier: GPL-2.0-only
config SND_SOC_ZED_SND_CARD
	tristate "Audio support for the the Zedboard ADAU1761 sound card."
	depends on SND_SOC_ADAU1761_I2C
	select SND_SEQ_MIDI_EMUL
	select SND_SEQ_MIDI_EVENT
	select SND_SEQUENCER
	help
	  Select this option to enable Zedboard sound card
	  support using ADAU1761 CODEC
```
